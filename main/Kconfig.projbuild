## main/Kconfig.projbuild
```kconfig
menu "lucky-page"

    config LUCKY_SKIP_HOMING_ON_BOOT
        bool "跳过开机归零（仅调试）"
        default n
        help
            跳过 10 秒机械等待以便快速迭代。开启时归零被跳过并打 WARN 日志。
            ⚠️ 出厂必须关闭（sdkconfig.defaults 显式 CONFIG_LUCKY_SKIP_HOMING_ON_BOOT=n，
            设计 R10 / D11）。

endmenu
```

## sdkconfig.defaults
```kconfig
# lucky-page 默认 SDK 配置（ESP32-S3 / N16R8：16MB Flash + 8MB Octal PSRAM）
# 基线：page-player/sdkconfig.defaults.esp32s3 裁剪（无 LVGL/显示/音频）

CONFIG_IDF_TARGET_ESP32S3=y
CONFIG_ESPTOOLPY_FLASHSIZE_16MB=y
CONFIG_PARTITION_TABLE_CUSTOM=y
CONFIG_PARTITION_TABLE_CUSTOM_FILENAME="partitions/16m.csv"

# --- PSRAM（最大化释放内部 RAM；N16R8 为 Octal） ---
CONFIG_SPIRAM=y
CONFIG_SPIRAM_MODE_OCT=y
CONFIG_SPIRAM_SPEED_80M=y
CONFIG_SPIRAM_USE_MALLOC=y
CONFIG_SPIRAM_MALLOC_ALWAYSINTERNAL=2048
CONFIG_SPIRAM_MALLOC_RESERVE_INTERNAL=8192
CONFIG_SPIRAM_TRY_ALLOCATE_WIFI_LWIP=y
CONFIG_SPIRAM_MEMTEST=n
CONFIG_SPIRAM_FETCH_INSTRUCTIONS=y
CONFIG_SPIRAM_RODATA=y
CONFIG_SPIRAM_ALLOW_BSS_SEG_EXTERNAL_MEMORY=y

# --- WiFi（裁剪内存占用） ---
CONFIG_ESP_WIFI_ENABLED=y
CONFIG_ESP_WIFI_STATIC_RX_BUFFER_NUM=4
CONFIG_ESP_WIFI_DYNAMIC_RX_BUFFER_NUM=8
CONFIG_ESP_WIFI_STATIC_TX_BUFFER_NUM=8
CONFIG_ESP_WIFI_CACHE_TX_BUFFER_NUM=8
CONFIG_ESP_WIFI_RX_BA_WIN=6
CONFIG_ESP_WIFI_TX_BA_WIN=6
CONFIG_ESP_WIFI_RX_MGMT_BUF_NUM_DEF=2
CONFIG_ESP_WIFI_MGMT_SBUF_NUM=12
CONFIG_ESP_WIFI_IRAM_OPT=n
CONFIG_ESP_WIFI_EXTRA_IRAM_OPT=n
CONFIG_ESP_WIFI_RX_IRAM_OPT=n

# --- LWIP ---
CONFIG_LWIP_MAX_SOCKETS=16
CONFIG_LWIP_MAX_ACTIVE_SOCKETS=16
CONFIG_LWIP_MAX_LISTENING_TCP=4
CONFIG_LWIP_TCP_MSL=30000
CONFIG_LWIP_TCP_SND_BUF_DEFAULT=2920
CONFIG_LWIP_TCP_WND_DEFAULT=2920
CONFIG_LWIP_TCP_RECVMBOX_SIZE=4
CONFIG_LWIP_TCP_ACCEPTMBOX_SIZE=4
CONFIG_LWIP_MAX_UDP_PCBS=4
CONFIG_LWIP_UDP_RECVMBOX_SIZE=4
CONFIG_LWIP_TCPIP_RECVMBOX_SIZE=16
CONFIG_LWIP_TCPIP_TASK_STACK_SIZE=2560
CONFIG_LWIP_DHCPS_MAX_STATION_NUM=4
CONFIG_LWIP_LOOPBACK_MAX_PBUFS=0
CONFIG_LWIP_TCP_QUEUE_OOSEQ=n

# --- mbedTLS ---
CONFIG_MBEDTLS_DYNAMIC_BUFFER=y
CONFIG_MBEDTLS_SSL_IN_CONTENT_LEN=4096
CONFIG_MBEDTLS_SSL_OUT_CONTENT_LEN=2048

# --- SPIFFS（assets 分区：Web 前端 + logo + 出厂 page_mapping.json） ---
CONFIG_SPIFFS_MAX_PARTITIONS=1
CONFIG_SPIFFS_GC_MAX_RUNS=4

# --- HTTPD（WebServer 用；端点较多，URI handler 上限调高） ---
CONFIG_HTTPD_MAX_REQ_HDR_LEN=1024
CONFIG_HTTPD_MAX_URI_LEN=256
CONFIG_HTTPD_MAX_URI_HANDLERS=32

# --- FreeRTOS / 系统 ---
CONFIG_CXX_EXCEPTIONS=y
CONFIG_FREERTOS_HZ=1000
CONFIG_FREERTOS_IDLE_TASK_STACKSIZE=1024
CONFIG_ESP_MAIN_TASK_STACK_SIZE=4096
CONFIG_ESP_SYSTEM_EVENT_QUEUE_SIZE=16
CONFIG_ESP_SYSTEM_EVENT_TASK_STACK_SIZE=4096
CONFIG_ESP_TIMER_TASK_STACK_SIZE=3072
CONFIG_LOG_DEFAULT_LEVEL_INFO=y
CONFIG_LOG_MAXIMUM_LEVEL_DEBUG=y

# --- FATFS (SD 卡，可选) ---
CONFIG_FATFS_LFN_HEAP=y
CONFIG_FATFS_CODEPAGE_WCHAR=y
CONFIG_FATFS_LONG_FILENAMES=y
CONFIG_FATFS_ALLOC_PREFER_EXTRAM=y
CONFIG_FATFS_VOLUME_COUNT=2

# --- 出厂必须关闭：跳过归零仅调试用（设计 R10 / D11） ---
CONFIG_LUCKY_SKIP_HOMING_ON_BOOT=n

# 本板唯一引出串口是 USB-Serial-JTAG（usbmodem）；主控制台切过去
CONFIG_ESP_CONSOLE_USB_SERIAL_JTAG=y
```
